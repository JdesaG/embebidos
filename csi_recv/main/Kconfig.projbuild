## csi_recv/main/Kconfig.projbuild
```kconfig
menu "CSI Receiver Network"

config CSI_UDP_PORT
    int "UDP destination port"
    range 1 65535
    default 5000
    help
        Puerto de ingesta anunciado por el servidor. La IP se descubre
        automaticamente y no se guarda en el firmware.

config CSI_UDP_QUEUE_LENGTH
    int "UDP queue length"
    range 4 64
    default 32
    help
        Number of frames buffered between the CSI callback and UDP task.

endmenu
```

## csi_send/main/Kconfig.projbuild
```kconfig
menu "CSI Sensor and Actuator Node"

config CSI_LIGHT_GPIO
    int "WS2812 data GPIO"
    range 0 39
    default 25

config CSI_LIGHT_LED_COUNT
    int "Number of WS2812 LEDs"
    range 1 64
    default 16

config CSI_LIGHT_MAX_BRIGHTNESS
    int "Maximum LED brightness (0-255)"
    range 1 255
    default 76
    help
        76 is about 30 percent and protects the 5 V power-bank budget.

endmenu
```
